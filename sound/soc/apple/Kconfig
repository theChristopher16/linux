## sound/soc/apple/Kconfig
```kconfig
config SND_SOC_APPLE_MCA
	tristate "Apple Silicon MCA driver"
	depends on ARCH_APPLE || COMPILE_TEST
	select SND_DMAENGINE_PCM
	default ARCH_APPLE
	help
	  This option enables an ASoC platform driver for MCA peripherals found
	  on Apple Silicon SoCs.

config SND_SOC_APPLE_S5L_AUDIO
	tristate "iPad mini 1 speakers (Apple A5 MCA, CDMA, CS35L19)"
	depends on ARCH_APPLE_S5L || COMPILE_TEST
	depends on COMMON_CLK && I2C
	select SND_SOC_CS35L19
	default ARCH_APPLE_S5L
	help
	  The iPad mini 1 (A5, S5L8942X) speakers: the MCA audio port, its
	  CDMA channel and the clocks and pin routing they need, as an ALSA
	  card with the two CS35L19 amplifiers.
```
